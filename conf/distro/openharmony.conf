## conf/distro/openharmony.conf
```bitbake
# SPDX-FileCopyrightText: Huawei Inc.
#
# SPDX-License-Identifier: Apache-2.0

DISTRO = "openharmony"
DISTRO_NAME = "OpenHarmony Distro"
DISTRO_VERSION = "1.0"

MAINTAINER = "Francesco Pham <pham.francesco@gmail.com>"

LICENSE_FLAGS_ACCEPTED = "synaptics-killswitch"

# LLVM/Clang toolchain
TOOLCHAIN = "clang"
RUNTIME = "llvm"

# musl libc
TCLIBC = "musl"

PREFERRED_PROVIDER_virtual/kernel = "linux-openharmony"

PREFERRED_PROVIDER_virtual/java-initial-native ?= "cacao-initial-native"
PREFERRED_PROVIDER_virtual/java-native ?= "cacao-native"

# Attempt to isolate the buidl system from the host distribution's C library
require conf/distro/include/yocto-uninative.inc
INHERIT += "uninative"

# Add truncate host tool which is used by ohos mkimage scripts
HOSTTOOLS += "truncate"

# Default to enabling serial debug console on RaspberryPi
# Placed here to amend the machine config living in meta-raspberrypi
ENABLE_UART:raspberrypi4 ?= "1"

# Allow running the system without hdmi display connected
DISABLE_VC4GRAPHICS:raspberrypi4 = "1"
RPI_EXTRA_CONFIG:raspberrypi4 = ' \n \
    dtoverlay=vc4-fkms-v3d \n \
    '
    
HDMI_FORCE_HOTPLUG:raspberrypi4 = "1"
```
